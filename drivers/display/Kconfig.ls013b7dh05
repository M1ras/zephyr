## drivers/display/Kconfig.ls013b7dh05
```kconfig
# Kconfig - LS013B7DH05 display driver configuration options

#
# Copyright (c) 2018 Miras Absar
#
# SPDX-License-Identifier: Apache-2.0
#

menuconfig LS013B7DH05
	bool "LS013B7DH05 display driver"
	depends on MINIMAL_LIBC_MALLOC_ARENA_SIZE != 0 && SPI && GPIO && HAS_DTS_SPI && HAS_DTS_GPIO
	help
	  Enable the LS013B7DH05 display driver.
```

## drivers/sensor/icm20948_i2c/Kconfig
```kconfig
#
# Copyright (c) 2018 Miras Absar
#
# SPDX-License-Identifier: Apache-2.0
#

menuconfig ICM20948_I2C
	bool "ICM-20948 sensor I2C driver"
	depends on I2C && HAS_DTS_I2C
	help
	  Enable the ICM-20948 sensor I2C driver.

if ICM20948_I2C

choice
	prompt "Trigger mode"
	default ICM20948_I2C_TRIGGER_NONE
	help
	  Choose the type of triggering used by the driver.

config ICM20948_I2C_TRIGGER_NONE
	bool "No trigger"

config ICM20948_I2C_TRIGGER_GLOBAL_THREAD
	bool "Trigger on global thread"
	depends on GPIO && HAS_DTS_GPIO
	select ICM20948_I2C_TRIGGER

endchoice

config ICM20948_I2C_TRIGGER
	bool

endif
```

## dts/bindings/display/sharp,ls013b7dh05.yaml
```yaml
#
# Copyright (c) 2018 Miras Absar
#
# SPDX-License-Identifier: Apache-2.0
#
---
title: Sharp LS013B7DH05 Display
version: 0.1

description: This is a representation of the Sharp LS013B7DH05 display.

inherits:
    !include spi-device.yaml

properties:
    compatible:
      constraint: "sharp,ls013b7dh05"

    scs-gpios:
      type: compound
      category: required
      generation: define, use-prop-name
...
```

## dts/bindings/sensor/tdk,icm20948.yaml
```yaml
#
# Copyright (c) 2018 Miras Absar
#
# SPDX-License-Identifier: Apache-2.0
#
---
title: TDK InvenSense ICM-20948
version: 0.1

description: >
    This is a representation of the TDK InvenSense ICM-20948.

inherits:
    !include i2c-device.yaml

properties:
    compatible:
      constraint: "tdk,icm20948"

    int-gpios:
      type: compound
      category: required
      generation: define, use-prop-name
...
```
